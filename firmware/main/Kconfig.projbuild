## firmware/main/Kconfig.projbuild
```kconfig
menu "VanDeck"

config VD_SIMULATE
    bool "Show demo data for devices that are not paired"
    default n

config VD_BIG_FONTS
    bool "Use generated large numeral fonts (main/fonts/vd_num_*.c)"
    default n
    help
        Run tools/gen_fonts.sh first. Without it, big numbers fall back to Montserrat 48.

config VD_OTA_KEY
    string "OTA upload key"
    default "vandeck"
    help
        Sent by tools/ota.sh in the X-OTA-Key header; uploads without it are refused. Change it from the default.

config VD_TAILNET_HOSTNAME
    string "Tailnet device name"
    default "vandeck"
    help
        The name the panel registers with on your tailnet (MagicDNS: <name>.<tailnet>.ts.net). The tailnet itself
        is switched on in Settings > Tailnet, or with the 'tailnet' console command.

config VD_BATT_CAPACITY_AH
    int "Capacity of one battery (Ah)"
    default 160

config VD_PV_ARRAY_W
    int "Solar array peak power (W)"
    range 20 2000
    default 220
    help
        Starting value for Settings > Solar > Panel capacity, which the forecast's expected yield uses.

config VD_PV_PERF_PCT
    int "Solar system efficiency (%)"
    range 30 100
    default 80
    help
        Starting value for Settings > Solar > System efficiency: the share of the panels' rated output that ends up
        in the battery on flat roof mounting. 80 % suits an MPPT charger (panel heat ~10 %, wiring and MPPT
        conversion ~5 %, dirt and shade); a PWM charger is nearer 65-70 %. Tune it on the panel if the forecast is off.

menu "Truma Combi (LIN)"
    choice VD_LIN_MODE
        prompt "LIN role"
        default VD_LIN_MODE_INETBOX
        config VD_LIN_MODE_INETBOX
            bool "iNet box (CP Plus stays master)"
            help
                Emulate a Truma iNet box: the CP Plus keeps controlling the heater and this panel reads its status
                and sends setting changes through it. Needs an "inet ready" CP Plus; run "PR SET" on it once so
                it registers the iNet box.
        config VD_LIN_MODE_SNIFF
            bool "Sniff only (log frames, never transmit)"
        config VD_LIN_MODE_MASTER
            bool "Master, replacing the CP Plus (unfinished)"
            help
                Frame table not implemented. Never use with the CP Plus still on the bus.
    endchoice
    config VD_LIN_UART_NUM
        int "UART port"
        default 1
    config VD_LIN_TX_GPIO
        int "TX GPIO (to TJA1021/MCP2003 TXD)"
        range -1 54
        default 3
        help
            Expansion header IO3 (TX) and IO2 (RX), 3.3 V logic (the PCB has the two header pins swapped). TXD and RXD both need
            external pull-ups (2.2-4.7k to 3.3 V) or received frames fail their checksum.
    config VD_LIN_RX_GPIO
        int "RX GPIO (from transceiver RXD)"
        range -1 54
        default 2
    config VD_LIN_EN_GPIO
        int "Transceiver SLP_N / CS GPIO (-1 = tied high)"
        range -1 54
        default -1
    config VD_LIN_BAUD
        int "Baud rate"
        default 9600
endmenu

menu "KIB tank sensors"
    choice VD_TANK_MODE
        prompt "Sensor wiring"
        default VD_TANK_MODE_NONE
        config VD_TANK_MODE_NONE
            bool "Not connected"
        config VD_TANK_MODE_DIGITAL
            bool "Digital probe lines (1/3, 2/3, F per tank)"
        config VD_TANK_MODE_ADC
            bool "One analog sender per tank"
    endchoice
    config VD_TANK_PWR_GPIO
        int "Probe power enable GPIO (-1 = always powered)"
        range -1 54
        default -1
    config VD_TANK_ACTIVE_LOW
        bool "Digital lines are active low"
        default y
        depends on VD_TANK_MODE_DIGITAL
    config VD_TANK_LPG_GPIO_1
        int "LPG 1/3 GPIO"
        range -1 54
        default -1
        depends on VD_TANK_MODE_DIGITAL
    config VD_TANK_LPG_GPIO_2
        int "LPG 2/3 GPIO"
        range -1 54
        default -1
        depends on VD_TANK_MODE_DIGITAL
    config VD_TANK_LPG_GPIO_3
        int "LPG F GPIO"
        range -1 54
        default -1
        depends on VD_TANK_MODE_DIGITAL
    config VD_TANK_GREY_GPIO_1
        int "Grey 1/3 GPIO"
        range -1 54
        default -1
        depends on VD_TANK_MODE_DIGITAL
    config VD_TANK_GREY_GPIO_2
        int "Grey 2/3 GPIO"
        range -1 54
        default -1
        depends on VD_TANK_MODE_DIGITAL
    config VD_TANK_GREY_GPIO_3
        int "Grey F GPIO"
        range -1 54
        default -1
        depends on VD_TANK_MODE_DIGITAL
    config VD_TANK_LPG_ADC_CH
        int "LPG ADC1 channel (-1 = none)"
        range -1 13
        default -1
        depends on VD_TANK_MODE_ADC
    config VD_TANK_GREY_ADC_CH
        int "Grey ADC1 channel (-1 = none)"
        range -1 13
        default -1
        depends on VD_TANK_MODE_ADC
    config VD_TANK_ADC_T1
        int "Threshold for 1/3 (mV)"
        default 800
        depends on VD_TANK_MODE_ADC
    config VD_TANK_ADC_T2
        int "Threshold for 2/3 (mV)"
        default 1600
        depends on VD_TANK_MODE_ADC
    config VD_TANK_ADC_T3
        int "Threshold for F (mV)"
        default 2400
        depends on VD_TANK_MODE_ADC
    config VD_TANK_ADC_INVERT
        bool "Lower voltage means fuller (thresholds descending)"
        default n
        depends on VD_TANK_MODE_ADC
endmenu

endmenu
```

## relay/main/Kconfig.projbuild
```kconfig
menu "VanRelay"

config RELAY_GPIO
    int "Relay driver GPIO to the relay module IN pin"
    default 25
    help
        Wired straight to the module IN pin. Avoid the strapping pins (0, 2, 12, 15).

choice RELAY_TRIGGER
    prompt "Relay module trigger"
    default RELAY_ACTIVE_HIGH
    help
        Must match the H/L jumper on the relay module. With the jumper on H the module closes when IN is high
        (3.3 V from the ESP32 is enough on the 5 V module). On L it closes when IN is pulled low; the GPIO is then
        driven open-drain, so "off" releases the pin instead of driving 3.3 V against the module's pull-up.
    config RELAY_ACTIVE_HIGH
        bool "Active high (jumper on H)"
    config RELAY_ACTIVE_LOW
        bool "Active low (jumper on L)"
endchoice

config RELAY_KEY
    string "Shared key"
    default "vandeck-relay"
    help
        Must equal VD_RELAY_KEY in the panel firmware (max 16 characters). Writes without it are refused.

choice RELAY_BOOT
    prompt "State after power-up"
    default RELAY_BOOT_LAST
    config RELAY_BOOT_LAST
        bool "Restore the last state"
    config RELAY_BOOT_OFF
        bool "Off"
    config RELAY_BOOT_ON
        bool "On"
endchoice

config RELAY_LINK_LOSS_OFF_MIN
    int "Switch off after this many minutes without the panel (0 = never)"
    default 0
    help
        The panel polls the relay about every minute. Set this to power Starlink down if the panel is gone.

endmenu
```

## relay/sdkconfig.defaults
```kconfig
CONFIG_BT_ENABLED=y
CONFIG_BT_BLUEDROID_ENABLED=n
CONFIG_BT_NIMBLE_ENABLED=y
CONFIG_BT_NIMBLE_MAX_CONNECTIONS=1
CONFIG_BT_NIMBLE_ROLE_CENTRAL=n
CONFIG_BT_NIMBLE_ROLE_OBSERVER=n
CONFIG_BT_NIMBLE_DEVICE_NAME_MAX_LEN=16
CONFIG_BOOTLOADER_APP_ROLLBACK_ENABLE=n
```
